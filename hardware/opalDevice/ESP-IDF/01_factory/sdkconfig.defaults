## hardware/opalDevice/ESP-IDF/01_factory/sdkconfig.defaults
```kconfig
CONFIG_IDF_TARGET="esp32c6"

CONFIG_ESPTOOLPY_FLASHSIZE_16MB=y
CONFIG_ESPTOOLPY_FLASHMODE_QIO=y
CONFIG_PARTITION_TABLE_CUSTOM=y

CONFIG_LV_COLOR_16_SWAP=y
CONFIG_LV_FONT_MONTSERRAT_12=y
CONFIG_LV_FONT_MONTSERRAT_16=y
CONFIG_LV_FONT_MONTSERRAT_20=y
CONFIG_LV_USE_DEMO_WIDGETS=y
CONFIG_LV_USE_DEMO_BENCHMARK=y
CONFIG_LV_USE_DEMO_STRESS=y
CONFIG_LV_USE_DEMO_MUSIC=y

## LVGL8 ##
CONFIG_LV_MEM_SIZE_KILOBYTES=48

CONFIG_CODEC_I2C_BACKWARD_COMPATIBLE=n
```

## hardware/opalDevice/firmware/esp32-s3-amoled/sdkconfig.defaults
```kconfig
# Target
CONFIG_IDF_TARGET="esp32s3"

# Flash size 16MB
CONFIG_ESPTOOLPY_FLASHSIZE_16MB=y
CONFIG_ESPTOOLPY_FLASHSIZE="16MB"

# PSRAM Settings for ESP32-S3R8 (Octal SPIRAM)
CONFIG_ESP32S3_SPIRAM_SUPPORT=y
CONFIG_SPIRAM_MODE_OCT=y
CONFIG_SPIRAM_SPEED_80M=y

# Partition Table
CONFIG_PARTITION_TABLE_CUSTOM=y
CONFIG_PARTITION_TABLE_CUSTOM_FILENAME="partitions.csv"
```
